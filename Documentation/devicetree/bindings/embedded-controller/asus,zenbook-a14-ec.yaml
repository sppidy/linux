## Documentation/devicetree/bindings/embedded-controller/asus,zenbook-a14-ec.yaml
```yaml
# SPDX-License-Identifier: (GPL-2.0-only OR BSD-2-Clause)
%YAML 1.2
---
$id: http://devicetree.org/schemas/embedded-controller/asus,zenbook-a14-ec.yaml#
$schema: http://devicetree.org/meta-schemas/core.yaml#

title: ASUS Zenbook A14 Embedded Controller

maintainers:
  - Sombre-Osmoze <sombre@osmoze.xyz>

description:
  The ASUS Zenbook A14 carries an embedded controller at I2C address 0x5b.
  It provides fan tachometers, per-fan PWM control, an EC temperature sensor,
  and firmware-backed performance profiles.

properties:
  compatible:
    const: asus,zenbook-a14-ec

  reg:
    const: 0x5b

required:
  - compatible
  - reg

additionalProperties: false

examples:
  - |
    i2c {
        #address-cells = <1>;
        #size-cells = <0>;

        embedded-controller@5b {
            compatible = "asus,zenbook-a14-ec";
            reg = <0x5b>;
        };
    };
```

## Documentation/devicetree/bindings/media/i2c/himax,hm1092.yaml
```yaml
# SPDX-License-Identifier: (GPL-2.0 OR BSD-2-Clause)
%YAML 1.2
---
$id: http://devicetree.org/schemas/media/i2c/himax,hm1092.yaml#
$schema: http://devicetree.org/meta-schemas/core.yaml#

title: Himax HM1092 Monochrome NIR Sensor

maintainers:
  - sppidy <sppidytg@gmail.com>

description:
  The Himax HM1092 is a 1 megapixel monochrome near-infrared CMOS image
  sensor with a MIPI CSI-2 interface, commonly used as the IR camera for
  face authentication on laptops. It supports 10 bit RAW output at
  1288x728 over 1 or 2 CSI-2 data lanes. An optional infrared
  illuminator LED may be associated with the sensor through the generic
  "leds" property; the driver strobes it while the sensor is streaming
  so the scene stays lit for IR capture.

allOf:
  - $ref: /schemas/media/video-interface-devices.yaml#

properties:
  compatible:
    const: himax,hm1092

  reg:
    maxItems: 1

  clocks:
    maxItems: 1

  avdd-supply:
    description: Analogue circuit voltage supply.

  dovdd-supply:
    description: I/O circuit voltage supply.

  dvdd-supply:
    description: Digital circuit voltage supply.

  reset-gpios:
    maxItems: 1
    description: Active low GPIO connected to the XSHUTDOWN pad.

  leds:
    description:
      Optional phandle to an infrared illuminator flash LED strobed by
      the driver while streaming.

  port:
    $ref: /schemas/graph.yaml#/$defs/port-base
    additionalProperties: false

    properties:
      endpoint:
        $ref: /schemas/media/video-interfaces.yaml#
        additionalProperties: false

        properties:
          data-lanes:
            minItems: 1
            maxItems: 2
          link-frequencies: true
          remote-endpoint: true

        required:
          - data-lanes
          - link-frequencies
          - remote-endpoint

required:
  - compatible
  - reg
  - clocks
  - port

unevaluatedProperties: false

examples:
  - |
    #include <dt-bindings/gpio/gpio.h>

    i2c {
        #address-cells = <1>;
        #size-cells = <0>;

        camera@24 {
            compatible = "himax,hm1092";
            reg = <0x24>;

            reset-gpios = <&tlmm 109 GPIO_ACTIVE_LOW>;
            pinctrl-names = "default";
            pinctrl-0 = <&cam_ir_default>;

            clocks = <&camcc 1>;
            assigned-clocks = <&camcc 1>;
            assigned-clock-rates = <24000000>;

            orientation = <0>;

            leds = <&ir_flash>;

            avdd-supply = <&vreg_l7m_2p9>;
            dvdd-supply = <&vreg_l7m_2p9>;
            dovdd-supply = <&vreg_l4m_1p8>;

            port {
                hm1092_ep: endpoint {
                    data-lanes = <1>;
                    link-frequencies = /bits/ 64 <400000000>;
                    remote-endpoint = <&camss_csiphy0_inep>;
                };
            };
        };
    };
...
```
